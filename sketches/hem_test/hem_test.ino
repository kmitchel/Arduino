/*
 * hem_test.ino - OLED Display Monitor
 * 
 * Hardware: ESP8266 with SSD1306 OLED display + buttons
 * Purpose: Displays power consumption, temperature, and HVAC status on OLED screen
 * 
 * MQTT Topics:
 *   Subscribe: power/W, temp/tempF, hvac/state
 * 
 * Dependencies:
 *   - ESP8266WiFi
 *   - PubSubClient (MQTT)
 *   - SSD1306 (display driver)
 *   - ArduinoOTA
 */

#include <ESP8266WiFi.h>
#include <ESP8266mDNS.h>
#include <WiFiUdp.h>
#include <ArduinoOTA.h>
#include <PubSubClient.h>
#include <Wire.h>
#include "SSD1306.h"

#define OLED_SDA 4  // pin 14
#define OLED_SDC 5  // pin 12
#define OLED_ADDR 0x3C

SSD1306 display(OLED_ADDR, OLED_SDA, OLED_SDC);

WiFiClient espClient;
PubSubClient mqtt(espClient);

const char* server = "raspberrypi";
const char* ssid = "Mitchell";
const char* password = "easypassword";

int power, temp, icon;

const uint8_t READY = 1, NEXTBTN = 2;
uint8_t state = READY;

void callback(char* topic, byte* payload, unsigned int length) {
  String payloads;
  for (int i = 0; i < length; i++) {
    payloads += (char)payload[i];
  }
  
  if (strcmp(topic, "power/W") == 0) {
    int thisNumber = payloads.toInt();
    if (thisNumber > 0) {
      power = thisNumber;
      draw();
    }
  }
  
  if (strcmp(topic, "temp/tempF") == 0) {
    int thisNumber = payloads.toInt();
    if (thisNumber > 0) {
      temp = thisNumber;
      draw();
    }
  }
  
  if (strcmp(topic, "hvac/state") == 0) {
    if (strcmp(payloads.c_str(), "CoolReady") == 0 || strcmp(payloads.c_str(), "HeatReady") == 0) {
      icon = 0;
    }
    if (strcmp(payloads.c_str(), "CoolOn") == 0 || strcmp(payloads.c_str(), "Cooling") == 0) {
      icon = 1;
    }
    if (strcmp(payloads.c_str(), "HeatOn") == 0 || strcmp(payloads.c_str(), "Heating") == 0) {
      icon = 2;
    }
    if (strcmp(payloads.c_str(), "FanWait") == 0 || strcmp(payloads.c_str(), "Wait") == 0) {
      icon = 3;
    }
    draw();
  }
}

// Icon bitmaps for HVAC status
static char cool[] = {
  0x00, 0x00, 0x00, 0x00, 0x01, 0x00, 0x00, 0x00, 0x00, 0x00, 0x00, 0xC0,
  0x03, 0x00, 0x00, 0x00, 0x00, 0x00, 0x00, 0xC0, 0x03, 0x00, 0x00, 0x00,
  0x00, 0x00, 0x00, 0xE0, 0x07, 0x00, 0x00, 0x00, 0x00, 0x00, 0x80, 0xC3,
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  0x00, 0x00, 0x00, 0x00, 0x00, 0x00, 0x00, 0x00
};

static char heat[] = {
  0x00, 0x00, 0x00, 0x00, 0x00, 0x00, 0x00, 0x00, 0x00, 0x00, 0x00, 0x18,
  0x00, 0x00, 0x00, 0x00, 0x00, 0x00, 0x00, 0x78, 0x00, 0x00, 0x00, 0x00,
  0x00, 0x00, 0x00, 0xF0, 0x00, 0x00, 0x00, 0x00, 0x00, 0x00, 0x00, 0xF8,
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  0x00, 0x00, 0x00, 0x00, 0x00, 0x00, 0x00, 0x00
};

static char waiting[] = {
  0x80, 0x26, 0x49, 0x92, 0x24, 0x49, 0x92, 0x00, 0xC0, 0xFF, 0xFF, 0xFF,
  0xFF, 0xFF, 0xFF, 0x03, 0xE0, 0xFF, 0xFF, 0xFF, 0xFF, 0xFF, 0xFF, 0x07,
  0xE0, 0xFF, 0xFF, 0xFF, 0xFF, 0xFF, 0xFF, 0x07, 0xE0, 0xBF, 0xA5, 0x55,
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  0x40, 0x92, 0x24, 0x49, 0x92, 0x24, 0x49, 0x02
};

void draw() {
  if (state == READY) {
    display.clear();

    // Show power consumption
    display.drawString(0, 0, String(power) + " W");

    // Show temperature
    display.drawString(0, 19, String(temp) + " F");

    // Show HVAC status icon
    switch (icon) {
      case 0:  // Ready - no icon
        break;
      case 1:  // Cooling
        display.drawXbm(63, 0, 64, 64, cool);
        break;
      case 2:  // Heating
        display.drawXbm(63, 0, 64, 64, heat);
        break;
      case 3:  // Waiting
        display.drawXbm(63, 0, 64, 64, waiting);
        break;
    }

    display.display();
  }
}

void wifiConnect() {
  WiFi.mode(WIFI_STA);
  WiFi.begin(ssid, password);
  while (WiFi.status() != WL_CONNECTED) {
    delay(200);
    digitalWrite(2, !digitalRead(2));
  }
  digitalWrite(2, 1);
}

void mqttConnect() {
  mqtt.setServer(server, 1883);
  mqtt.setCallback(callback);
  if (mqtt.connect(WiFi.hostname().c_str())) {
    mqtt.subscribe("power/W");
    mqtt.subscribe("temp/tempF");
    mqtt.subscribe("hvac/state");
  }
}

void setup() {
  Serial.begin(9600);
  pinMode(2, OUTPUT);
  digitalWrite(2, 0);

  pinMode(12, INPUT_PULLUP);
  pinMode(13, INPUT_PULLUP);

  ArduinoOTA.onStart([]() {
    Serial.println("Start");
  });
  ArduinoOTA.onEnd([]() {
    Serial.println("\nEnd");
  });
  ArduinoOTA.onProgress([](unsigned int progress, unsigned int total) {
    Serial.printf("Progress: %u%%\r", (progress / (total / 100)));
    digitalWrite(2, !digitalRead(2));
  });
  ArduinoOTA.onError([](ota_error_t error) {
    Serial.printf("Error[%u]: ", error);
    if (error == OTA_AUTH_ERROR) Serial.println("Auth Failed");
    else if (error == OTA_BEGIN_ERROR) Serial.println("Begin Failed");
    else if (error == OTA_CONNECT_ERROR) Serial.println("Connect Failed");
    else if (error == OTA_RECEIVE_ERROR) Serial.println("Receive Failed");
    else if (error == OTA_END_ERROR) Serial.println("End Failed");
  });

  wifiConnect();
  mqttConnect();
  ArduinoOTA.setHostname("test");
  ArduinoOTA.begin();

  display.init();
  display.setFont(ArialMT_Plain_16);
}

void loop() {
  if (WiFi.status() != WL_CONNECTED) {
    wifiConnect();
  }

  if (!mqtt.connected()) {
    mqttConnect();
  }

  mqtt.loop();
  ArduinoOTA.handle();

  static bool btnUp = false, btnDwn = false;
  static unsigned long lastBtnUp = 0, lastBtnDwn = 0;

  // Button handling
  if (digitalRead(12) == 0 && digitalRead(13) == 0 && millis() > lastBtnDwn && millis() > lastBtnUp) {
    lastBtnDwn = millis() + 500;
    btnDwn = true;
    lastBtnUp = millis() + 500;
    btnUp = true;
  }

  if (digitalRead(12) == 0 && digitalRead(13) == 1 && millis() > lastBtnUp) {
    lastBtnUp = millis() + 500;
    btnUp = true;
  }
  
  if (digitalRead(13) == 0 && digitalRead(12) == 1 && millis() > lastBtnDwn) {
    lastBtnDwn = millis() + 500;
    btnDwn = true;
  }

  switch (state) {
    case READY:
      if (btnUp && !btnDwn) {
        display.clear();
        display.display();
        state = NEXTBTN;
      }
      btnUp = false;
      btnDwn = false;
      break;
      
    case NEXTBTN:
      if (btnUp && btnDwn) {
        state = READY;
      }
      btnUp = false;
      btnDwn = false;
      break;
  }
}
